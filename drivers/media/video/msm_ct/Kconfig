## drivers/media/video/msm_ct/Kconfig
```kconfig
config MSM_CAMERA_SHR_CT
	bool "SHR CT"
	depends on ARCH_MSM
	default n
	---help---
	  SHR_CT

config QS_S5K4E1
	bool "Sensor qs_s5k4e1 (Samsung 5M)"
	depends on MSM_CAMERA && ARCH_MSM8X60 && !MSM_CAMERA_V4L2
	default n
	---help---
	  Samsung 5M with Autofocus
```

## drivers/staging/ti-st/Kconfig
```kconfig
#
# TI's shared transport line discipline and the protocol
# drivers (BT, FM and GPS)
#
menu "Texas Instruments shared transport line discipline"
    config TI_ST
    tristate "shared transport core driver"
    select FW_LOADER
    help
        This enables the shared transport core driver for TI
	    BT / FM and GPS combo chips.This enables protocol drivers
	    to register themselves with core and send data, the responses
	    are returned to relevant protocol drivers based on their
	    packet types.

    config TI_ST_BT
    tristate "BlueZ bluetooth driver for ST"
    select BT
    select TI_ST
    help
       This enables the Bluetooth driver for TI BT/FM/GPS combo devices
       This makes use of shared transport line discipline core driver to
       communicate with the BT core of the combo chip.

     config TI_ST_FM
     tristate "fm driver for ST"
     select TI_ST
     help
        This enables the FM driver for TI BT/FM/GPS combo devices
        This makes use of shared transport line discipline core driver to
        communicate with the FM core of the combo chip.
   config TI_ST_GPS
   tristate "GPS driver for ST"
   select TI_ST
   help
       This enables the GPS driver for TI BT/FM/GPS combo devices
       It will provide a character device for TI GPS Host software to access
       GPS functionality of Connectivity chip via ST driver
endmenu
```

## net/bluetooth/tihidp/Kconfig
```kconfig
config BT_TIHIDP
	tristate "TI-HIDP protocol support"
	depends on BT && INPUT
	select HID
	help
	  TI-HIDP (Human Interface Device Protocol) is a transport layer
	  for HID reports.  HIDP is required for the Bluetooth Human
	  Interface Device Profile.

	  This version is specialized for Texas Instruments

	  Say Y here to compile HIDP support into the kernel or say M to
	  compile it as module (hidp).
```
